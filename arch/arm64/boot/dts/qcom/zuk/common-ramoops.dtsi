&reserved_memory {
	ramoops_mem: ramoops_mem_region {
		no-map;
		reg = <0x0 0x9ff00000 0x0 0x00100000>;
		label = "ramoops_mem";
	};

};

&soc {
	ramoops {
		compatible = "ramoops";
		status = "ok";

		console-size = <0x0 0x80000>;
		record-size = <0x0 0x10000>;
		ftrace-size  = <0x0 0x10000>;
		pmsg-size = <0x0 0x20000>;

		memory-region = <&ramoops_mem>;

	};
};